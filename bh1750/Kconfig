## bh1750/Kconfig
```kconfig
#Create some new option in menuconfig
config CUSTOM_BH1750
    bool "Custom I2C light sensor BH1750"
    default n           # Set the driver to disabled at default
    depends on I2C      # BH1750 driver depend on I2C module
    depends on LOG      # BH1750 driver depend on Logging module
    help
        Enable the Custom I2C Light Sensor BH1750 driver.

config BH1750_CONTINUOUS_MODE
    bool "Continuous mode"
    default y                   # Set the BH1750 operate in continuous measurement mode at default
    depends on CUSTOM_BH1750    # This option is depend on Custom BH1750 module is enable
    help
        Enable continuous measurement operate mode for Custom BH1750 when make measurement.
```

## bh1750/dts/bindings/custom,bh1750.yaml
```yaml
description: My custom BH1750

compatible: "custom,bh1750"

include: [i2c-device.yaml]

properties:
  mode:
    type: int
    required: true
    description: |
      BH1750 operation mode option:
      - 0 : H-Resolution Mode
      - 1 : H-Resolution Mode 2
      - 2 : L-Resolution Mode
    enum:
      - 0
      - 1
      - 2
```

## rc522/Kconfig
```kconfig
config CUSTOM_RC522
    bool "Custom device driver for MFRC522 device"
    default n           # Set the driver to disabled at default
    depends on SPI      # RC522 driver depend on I2C module
    depends on LOG      # RC522 driver depend on Logging module
    depends on MULTITHREADING   # RC522 driver depend on multithreading module as implemented in real-time thread
    help
        Enable the Custom MFRC522 driver.
```

## rc522/dts/bindings/custom,rc522.yaml
```yaml
description: My custom MFRC522

compatible: "custom,rc522"

include: [spi-device.yaml]

properties:
  irq-gpios:
    type: phandle-array
    required: true
    description: |
      Define pin that connect to IRQ pin on MFRC522 to receive IRQ signal.
```
